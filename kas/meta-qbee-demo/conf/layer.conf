## kas/meta-qbee-demo/conf/layer.conf
```bitbake
BBPATH .= ":${LAYERDIR}"

BBFILES += "${LAYERDIR}/recipes-*/*/*.bb \
            ${LAYERDIR}/recipes-*/*/*.bbappend"

BBFILE_COLLECTIONS += "qbee-demo"
BBFILE_PATTERN_qbee-demo = "^${LAYERDIR}/"
BBFILE_PRIORITY_qbee-demo = "10"

LAYERDEPENDS_qbee-demo = "core rauc"
LAYERSERIES_COMPAT_qbee-demo = "wrynose"

# Public example keys from meta-rauc-community - development only
RAUC_KEY_FILE ?= "${LAYERDIR}/files/rauc-example-keys/development-1.key.pem"
RAUC_CERT_FILE ?= "${LAYERDIR}/files/rauc-example-keys/development-1.cert.pem"
RAUC_KEYRING_FILE ?= "${LAYERDIR}/files/rauc-example-keys/ca.cert.pem"
```
