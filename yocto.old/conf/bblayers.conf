## yocto.old/conf/bblayers.conf
```bitbake
#POKY_BBLAYERS_CONF_VERSION is increased each time build/conf/bblayers.conf
# changes incompatibly
POKY_BBLAYERS_CONF_VERSION = "2"

BBPATH = "${TOPDIR}"
BBFILES ?= ""

BBLAYERS ?= " \
  /home/jonhenrik/qbee/work/rauc-qemu-demo/layers/poky/meta \
  /home/jonhenrik/qbee/work/rauc-qemu-demo/layers/poky/meta-poky \
  /home/jonhenrik/qbee/work/rauc-qemu-demo/layers/poky/meta-yocto-bsp \
  /home/jonhenrik/qbee/work/rauc-qemu-demo/layers/meta-openembedded/meta-oe \
  /home/jonhenrik/qbee/work/rauc-qemu-demo/layers/meta-openembedded/meta-python \
  /home/jonhenrik/qbee/work/rauc-qemu-demo/layers/meta-qbee/meta-qbee \
  /home/jonhenrik/qbee/work/rauc-qemu-demo/layers/meta-rauc \
  /home/jonhenrik/qbee/work/rauc-qemu-demo/layers/meta-rauc-community/meta-rauc-qemux86 \
  /home/jonhenrik/qbee/work/rauc-qemu-demo/layers/meta-security/meta-tpm \
  "
```

## yocto.old/conf/local.conf
```bitbake
CONF_VERSION = "2"
INIT_MANAGER = "systemd"
DISTRO_FEATURES += "rauc tpm tpm2"
DISTRO_FEATURES:append = "rauc tpm tpm2"
MACHINE_FEATURES:append = " pcbios efi tpm2"
EXTRA_IMAGEDEPENDS += "ovmf"
PREFERRED_RPROVIDER_virtual-grub-bootconf = "rauc-qemu-grubconf"
CORE_IMAGE_EXTRA_INSTALL += "rauc packagegroup-security-tpm2"
INHERIT += "rm_work"

# We need a custom wks file, how to get it included in the build?
#WKS_FILE = "file:///qemux86-grub-efi.wks"

# Image config
hostname:pn-base-files = "qbeedemo"

BB_NUMBER_THREADS = "4"
BB_DISKMON_DIRS ??= "\
    STOPTASKS,${TMPDIR},1G,100K \
    STOPTASKS,${DL_DIR},1G,100K \
    STOPTASKS,${SSTATE_DIR},1G,100K \
    STOPTASKS,/tmp,100M,100K \
    HALT,${TMPDIR},100M,1K \
    HALT,${DL_DIR},100M,1K \
    HALT,${SSTATE_DIR},100M,1K \
    HALT,/tmp,10M,1K"

# qbee config - we do not set bootstrap key as that will be injected into the image on container
# startup
#QBEE_DEVICE_NAME_TYPE="mac-address"

# RAUC config

RAUC_SLOT_rootfs[fstype] = "ext4"
RAUC_SLOT_rootfs[adaptive] = "block-hash-index"
RAUC_KEYRING_FILE="/home/jonhenrik/qbee/work/rauc-qemu-demo/build/example-ca/ca.cert.pem"
RAUC_KEY_FILE="/home/jonhenrik/qbee/work/rauc-qemu-demo/build/example-ca/private/development-1.key.pem"
RAUC_CERT_FILE="/home/jonhenrik/qbee/work/rauc-qemu-demo/build/example-ca/development-1.cert.pem"
```
